## conf/layer.conf
```bitbake
# We have a conf and classes directory, add to BBPATH
BBPATH .= ":${LAYERDIR}"

# We have recipes-* directories, add to BBFILES
BBFILES += "${LAYERDIR}/recipes-*/*/*.bb \
            ${LAYERDIR}/recipes-*/*/*.bbappend"

BBFILE_COLLECTIONS += "lema"
BBFILE_PATTERN_lema = "^${LAYERDIR}/"
BBFILE_PRIORITY_lema = "10"

LAYERDEPENDS_lema = "core raspberrypi"
LAYERSERIES_COMPAT_lema = "kirkstone"
```
